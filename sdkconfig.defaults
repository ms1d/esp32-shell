## sdkconfig.defaults
```kconfig
# Disable WiFi / networking
CONFIG_ESP_WIFI_ENABLED=n
CONFIG_LWIP=n
CONFIG_MBEDTLS=n

# Disable filesystem
CONFIG_SPIFFS=n
CONFIG_FATFS=n
CONFIG_VFS_SUPPORT_IO=n

# Reduce logging
CONFIG_LOG_DEFAULT_LEVEL_NONE=y

# Disable unnecessary drivers
CONFIG_BT_ENABLED=n
CONFIG_ESP_EVENT_LOOP_PROFILING=n
```
